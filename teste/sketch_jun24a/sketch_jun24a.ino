#include "U8glib.h"

U8GLIB_SSD1306_128X64 u8g(U8G_I2C_OPT_NO_ACK);
 const uint8_t bullet[] U8G_PROGMEM = {
  0x00, 0x00, 0x00, 
  0x00, 0x00, 0x00, 
  0x00, 0x00, 0x00, 
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  0x00, 0x00, 0x00,    
};

const uint8_t smile[] U8G_PROGMEM = {
  0x07, 0xfe, 0x00, 
  0x1e, 0x07, 0x80, 
  0x3c, 0x03, 0xc0, 
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  0x07, 0xfe, 0x00,  
};

void setup(void) 
{
  pinMode(2, INPUT_PULLUP);  //Pino Eixo Z  
}
 
void loop(void) 
{
   u8g.firstPage();  
   float x, y;
   
   do
   { 
     x = analogRead(0); 
     y = analogRead(1); 
     u8g.drawBitmapP( (y/1024)*128-4, (x/1024)*64-4, 3, 20, smile);
     if (!digitalRead(2)) 
     {
      int i = 0;
      do{
        delay(100);
        u8g.drawBitmapP( (y/1024)*128+10*++i, (x/1024)*64, 3, 10, bullet);        
      }while(u8g.nextPage()&&i<10);
     }
   } while( u8g.nextPage() );
   //delay(50);
}
